/*
 * Copyright (c) 2022-2023 XiNGRZ
 * SPDX-License-Identifier: MIT
 */

/ {
	behaviors {
		/omit-if-no-ref/ mw: behavior_mouse_wheel {
			compatible = "zmk,behavior-mouse-wheel";
			#binding-cells = <1>;
			display-name = "Mouse Wheel";
		};
	};
};
