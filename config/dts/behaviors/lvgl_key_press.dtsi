/*
 * Copyright (c) 2022-2023 XiNGRZ
 * SPDX-License-Identifier: MIT
 */

/ {
	behaviors {
		/omit-if-no-ref/ lvkp: behavior_lvgl_key_press {
			compatible = "zmk,behavior-lvgl-key-press";
			#binding-cells = <1>;
			display-name = "LVGL Key Press";
		};
	};
};
