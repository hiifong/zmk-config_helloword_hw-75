## config/boards/helloword/hw75_dynamic/Kconfig.hw75_dynamic
```kconfig
# HW-75 board configuration

# Copyright (c) 2022 The ZMK Contributors
# Copyright (c) 2022-2025 XiNGRZ
# SPDX-License-Identifier: MIT

config BOARD_HW75_DYNAMIC
	select SOC_STM32F405XX
```

## config/boards/helloword/hw75_dynamic/board.yml
```yaml
board:
  name: hw75_dynamic
  full_name: HW-75 Dynamic
  vendor: helloword
  revision:
    format: letter
    default: B
    revisions:
      - name: A
      - name: B
  socs:
    - name: stm32f405xx
```

## config/boards/helloword/hw75_keyboard/board.yml
```yaml
board:
  name: hw75_keyboard
  full_name: HW-75 Keyboard
  vendor: helloword
  revision:
    format: major.minor.patch
    default: 1.2.0
    revisions:
      - name: 1.1.0
      - name: 1.2.0
  socs:
    - name: stm32f103xb
```

## config/west.yml
```yaml
manifest:
  projects:
    - name: zmk
      url: https://github.com/xingrz/zmk.git
      revision: zmkx-rel-20251223
      clone-depth: 10
      import:
        file: app/west.yml
        name-allowlist:
          - cmsis
          - cmsis-dsp
          - segger
          - hal_stm32
          - lvgl
          - nanopb
          - picolibc
          - zephyr
          - zmk-studio-messages
  self:
    path: config
```
